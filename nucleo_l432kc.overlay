/ {
    aliases {
        charge_en        = &charge_enable;
        charger_connect  = &charger_con;
        precharge_enable = &precharge_en;
        drive_precharge  = &drive_precharge;
    };
};

/* Ensure GPIOA and GPIOB are enabled */
&gpioa { status = "okay"; };
&gpiob { status = "okay"; };

/* Charge enable on PA9, active‐high */
charge_enable: charge_en {
    gpios = <&gpioa 9 GPIO_ACTIVE_HIGH>;
};

/* Charger connected sense on PA10, active‐low */
charger_con: charger_con {
    gpios = <&gpioa 10 GPIO_ACTIVE_LOW>;
};

/* Precharge enable on PB7, active‐high */
precharge_en: precharge_en {
    gpios = <&gpiob 7 GPIO_ACTIVE_HIGH>;
};

/* Drive precharge relay on PB6, active‐high */
drive_precharge: drive_precharge {
    gpios = <&gpiob 6 GPIO_ACTIVE_HIGH>;
};
